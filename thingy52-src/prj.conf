## CMakeLists.txt
```
# SPDX-License-Identifier: Apache-2.0

cmake_minimum_required(VERSION 3.20.0)
find_package(Zephyr REQUIRED HINTS $ENV{ZEPHYR_BASE})
project(blinky)

target_sources(app PRIVATE src/main.c src/gasSensor.h src/gasSensor.c src/humidity.h src/humidity.c src/battery.h src/battery.c)
```

## prj.conf
```kconfig
#
# Copyright (c) 2018 Nordic Semiconductor
#
# SPDX-License-Identifier: LicenseRef-Nordic-5-Clause
#
CONFIG_NCS_SAMPLES_DEFAULTS=y

CONFIG_BT=y
CONFIG_BT_PERIPHERAL=y
CONFIG_BT_DEVICE_NAME="Nordic_LBS"

# Enable the LBS service
CONFIG_BT_LBS=y
CONFIG_BT_LBS_POLL_BUTTON=y
CONFIG_DK_LIBRARY=y

# CONFIG_SYSTEM_WORKQUEUE_STACK_SIZE=2048
CONFIG_BOOTLOADER_MCUBOOT=y
CONFIG_MCUMGR=y
CONFIG_MCUMGR_SMP_BT=y
CONFIG_MULTITHREADING=y

# Enable mcumgr.
CONFIG_MCUMGR=y

# Enable most core commands.
CONFIG_MCUMGR_CMD_IMG_MGMT=y
CONFIG_MCUMGR_CMD_OS_MGMT=y
# Allow for large Bluetooth data packets.
CONFIG_BT_L2CAP_TX_MTU=252
CONFIG_BT_BUF_ACL_RX_SIZE=256

# Enable the Bluetooth (unauthenticated) and shell mcumgr transports.
CONFIG_MCUMGR_SMP_BT_AUTHEN=n

# # Some command handlers require a large stack.
CONFIG_SYSTEM_WORKQUEUE_STACK_SIZE=4096

# Logging settings
CONFIG_LOG_DEFAULT_LEVEL=4
CONFIG_LOG=y
CONFIG_LOG_MODE_DEFERRED=y
CONFIG_LOG_RUNTIME_FILTERING=y
CONFIG_LOG_BUFFER_SIZE=2048
CONFIG_LOG_PRINTK=y

CONFIG_BT_EXT_ADV=y
CONFIG_BT_EXT_ADV_MAX_ADV_SET=2

CONFIG_I2C=y
CONFIG_SENSOR=y

# Enable sfloat values
CONFIG_SFLOAT=y

# Enable the ADC
CONFIG_ADC=y

# CONFIG_HW_ID_LIBRARY=y
# CONFIG_HW_ID_LIBRARY_SOURCE_BLE_MAC=y
```

## src/main.c
```c
#include <dk_buttons_and_leds.h>
#include <zephyr/kernel.h>
#include <zephyr/bluetooth/bluetooth.h>
#include <zephyr/bluetooth/hci.h>
#include <zephyr/bluetooth/conn.h>
#include <string.h>
#include <zephyr/settings/settings.h>
#include <zephyr/logging/log_ctrl.h>
#include <zephyr/logging/log.h>
#include "gasSensor.h"
#include "humidity.h"
#include "battery.h"

LOG_MODULE_REGISTER(main);

#define RUN_STATUS_LED          DK_LED1
#define ADV_DONE_LED            DK_LED3
#define MANUFACTURER_ID         0x4548
#define FW_VERSION              0x01
#define ADV_INTERVAL_MS         2000

bool isRunning = true;

struct advertisementStruct {
    uint16_t companyID;
    uint8_t fwVersion;
    uint8_t rollover;
    float co2;
    uint16_t humidity;
    uint16_t temp;
    uint16_t batteryPercentage;
};

struct bt_le_ext_adv *advertisement;

struct advertisementStruct advertisementData = {
    MANUFACTURER_ID,
    FW_VERSION,
    0x00,
    0xFFFF,
    0xFF,
    0xFF,
    0xFF
};

struct bt_data advertisementPacket[] = {
    BT_DATA_BYTES(BT_DATA_FLAGS, (BT_LE_AD_GENERAL | BT_LE_AD_NO_BREDR)),
    BT_DATA(BT_DATA_MANUFACTURER_DATA, &advertisementData, sizeof(advertisementData))
};

void sentAdvertisement(struct bt_le_ext_adv *adv, struct bt_le_ext_adv_sent_info *info){    
    printk("Advertising packet transmitted successfully(%i).\n", info->num_sent);

    dk_set_led(ADV_DONE_LED, false);
    k_sleep(K_MSEC(10));
    dk_set_led(ADV_DONE_LED, true);

    k_sleep(K_MSEC(ADV_INTERVAL_MS));
    sendAdvertisement();
}

static struct bt_le_ext_adv_cb advertisingCallbacks = {
    .sent = sentAdvertisement,
	.connected = NULL,
    .scanned = NULL
};

void sendAdvertisement(){
    int err;
    // setting new sensor values here
    advertisementData.rollover++;
    advertisementData.co2 = getGasValue();
    advertisementData.batteryPercentage = getBatteryPercentage();

    err = readHumiditySensor();
    if(err == 0){
        advertisementData.humidity = getHumidityValue();
        advertisementData.temp = getTemperatureValue();
    } else {
        advertisementData.humidity = 0xFF;
        advertisementData.temp = 0xFF;
    }

    err = bt_le_ext_adv_set_data(advertisement, advertisementPacket, ARRAY_SIZE(advertisementPacket), NULL, 0);
    if (err) {
            printk("Failed to set advertising data (%d)\n", err);
            isRunning = false;
    }
    err = bt_le_ext_adv_start(advertisement, BT_LE_EXT_ADV_START_PARAM(0, 1));
    if (err) {
            printk("Failed to start advertising set (%d)\n", err);
            isRunning = false;
    }
    printk("Advertising packet sent.\n");
}

void main(void)
{
    int err;

    LOG_INF("Built on %s at %s\n", __DATE__, __TIME__);

    // Initialize Bluetooth subsystem
    err = bt_enable(NULL);
    if (err) {
        printk("Bluetooth init failed (err %d)\n", err);
        return;
    }

    // err = bt_le_ext_adv_create(BT_LE_EXT_ADV_CODED_NCONN_IDENTITY, NULL, &adv);
    err = bt_le_ext_adv_create(BT_LE_ADV_NCONN_IDENTITY, &advertisingCallbacks, &advertisement);
    if (err) {
        printk("Extended advertisement creation failed (err %d)\n", err);
        return;
    }

    err = initGasSensor();
    if(err) {
        printk("Gas sensor init failed (err %d)\n", err);
        return;
    }

    err = initHumiditySensor();
    if(err) {
        printk("Humidity sensor init failed (err %d)\n", err);
        return;
    }

     err = initBattery();
    if(err) {
        printk("Battery init failed (err %d)\n", err);
        return;
    }

    sendAdvertisement();

    int blinkStatus = 0;
    while (isRunning) {
        k_sleep(K_MSEC(300));
        
        dk_set_led(RUN_STATUS_LED, (++blinkStatus) % 2);
    }
    return;
}
```

## src/battery.c
```c
/*
 * Copyright (c) 2018-2019 Peter Bigot Consulting, LLC
 * Copyright (c) 2019-2020 Nordic Semiconductor ASA
 *
 * SPDX-License-Identifier: Apache-2.0
 */

#include "battery.h"
#include <math.h>
#include <stdio.h>
#include <stdlib.h>

#include <zephyr/kernel.h>
#include <zephyr/init.h>
#include <zephyr/drivers/gpio.h>
#include <zephyr/drivers/adc.h>
#include <zephyr/drivers/sensor.h>
#include <zephyr/logging/log.h>
#include <zephyr/logging/log_ctrl.h>
#include <sfloat.h>

#define VBATT DT_PATH(vbatt)
#define ZEPHYR_USER DT_PATH(zephyr_user)
#define BATTERY_ADC_GAIN ADC_GAIN_1

struct io_channel_config {
	uint8_t channel;
};

struct divider_config {
	struct io_channel_config io_channel;
	struct gpio_dt_spec power_gpios;
	/* output_ohm is used as a flag value: if it is nonzero then
	 * the battery is measured through a voltage divider;
	 * otherwise it is assumed to be directly connected to Vdd.
	 */
	uint32_t output_ohm;
	uint32_t full_ohm;
};

static const struct divider_config divider_config = {
	.io_channel = {
		DT_IO_CHANNELS_INPUT(VBATT),
	},
	.power_gpios = GPIO_DT_SPEC_GET_OR(VBATT, power_gpios, {}),
	.output_ohm = DT_PROP(VBATT, output_ohms),
	.full_ohm = DT_PROP(VBATT, full_ohms),
};

struct divider_data {
	const struct device *adc;
	struct adc_channel_cfg adc_cfg;
	struct adc_sequence adc_seq;
	int16_t raw;
};

static struct divider_data divider_data = {
	.adc = DEVICE_DT_GET(DT_IO_CHANNELS_CTLR(VBATT)),
};

int initBattery(){
	const struct divider_config *cfg = &divider_config;
	const struct io_channel_config *iocp = &cfg->io_channel;
	const struct gpio_dt_spec *gcp = &cfg->power_gpios;
	struct divider_data *ddp = &divider_data;
	struct adc_sequence *asp = &ddp->adc_seq;
	struct adc_channel_cfg *accp = &ddp->adc_cfg;
	int rc;

	#if DT_NODE_HAS_STATUS(VBATT, okay)
		printk("DT_NODE_STATUS_VBATT_OKAY");
	#endif

	#ifdef CONFIG_ADC_NRFX_SAADC
		printk("CONFIG_ADC_NRFX_SAADC");
	#endif

	if (!device_is_ready(ddp->adc)) {
		printk("ADC device is not ready %s", ddp->adc->name);
		return -ENOENT;
	}

	if (gcp->port) {
		if (!device_is_ready(gcp->port)) {
			printk("%s: device not ready", gcp->port->name);
			return -ENOENT;
		}
		rc = gpio_pin_configure_dt(gcp, GPIO_OUTPUT_INACTIVE);
		if (rc != 0) {
			printk("Failed to control feed %s.%u: %d",
				gcp->port->name, gcp->pin, rc);
			return rc;
		}
	}

	*asp = (struct adc_sequence){
		.channels = BIT(0),
		.buffer = &ddp->raw,
		.buffer_size = sizeof(ddp->raw),
		.oversampling = 4,
		.calibrate = true,
	};

	*accp = (struct adc_channel_cfg){
		.gain = BATTERY_ADC_GAIN,
		.reference = ADC_REF_INTERNAL,
		.acquisition_time = ADC_ACQ_TIME(ADC_ACQ_TIME_MICROSECONDS, 40),
	};

	if (cfg->output_ohm != 0) {
		accp->input_positive = SAADC_CH_PSELP_PSELP_AnalogInput0
			+ iocp->channel;
	} else {
		accp->input_positive = SAADC_CH_PSELP_PSELP_VDD;
	}

	asp->resolution = 14;

	rc = adc_channel_setup(ddp->adc, accp);
	printk("Setup AIN%u got %d", iocp->channel, rc);

	if(rc == 0){
		const struct gpio_dt_spec *gcp = &divider_config.power_gpios;
		if (gcp->port) {
			rc = gpio_pin_set_dt(gcp, true);
		}
	}

	if(rc == 0){
		printk("Battery setup OK");
	}
	else{
		printk("Battery setup failed");
	}
	return rc;
}

uint16_t getBatteryPercentage(){
	int rc = -ENOENT;

	struct divider_data *ddp = &divider_data;
	const struct divider_config *dcp = &divider_config;
	struct adc_sequence *sp = &ddp->adc_seq;

	rc = adc_read(ddp->adc, sp);
	sp->calibrate = false;
	if (rc == 0) {
		int32_t val = ddp->raw;

		adc_raw_to_millivolts(adc_ref_internal(ddp->adc),
						ddp->adc_cfg.gain,
						sp->resolution,
						&val);

		// See the Appendix B3 for the reasoning of the percentage formula
		float batteryMillivolt = (float) (val * (uint64_t)dcp->full_ohm / dcp->output_ohm);
		float voltage = batteryMillivolt / 1000;

		float percentage = (1.0919045 * voltage) - 10.2228467;
		//voltage formula: volt = 0.0105 * percentage + 3.1734
		// percentage formula: percentage = (volt - 3.1734) / 0.0105
		// float percentage = (batteryMillivolt - 3173.4) / 10.5;
		printk("Battery percentage: %d", (int) percentage);
		return sfloat_from_float(percentage).val;
	} else {
		printk("Battery read failed: %d", rc);
	}

	return rc;
}
```

## src/battery.h
```c
#ifndef BATTERY_H_
#define BATTERY_H_

#include <stdint.h>

int initBattery();
uint16_t getBatteryPercentage();

#endif /* BATTERY_H_ */
```

## src/gasSensor.c
```c
#include "gasSensor.h"
#include <zephyr/drivers/sensor/ccs811.h>
#include <zephyr/drivers/sensor.h>
#include <zephyr/kernel.h>
#include <zephyr/device.h>
#include <stdint.h>

const struct device *const ccs811 = DEVICE_DT_GET_ONE(ams_ccs811);

int initGasSensor() {
    return !device_is_ready(ccs811);
}

float getGasValue() {
    int err = 0;
    struct sensor_value co2, tvoc, voltage, current;
    // const struct ccs811_result_type *result = ccs811_result(dev);

    err = sensor_sample_fetch(ccs811);
    if(err != 0){
        printk("Error on sample fetching data from ccs811: %d\n", err);
        return -1;
    }

    sensor_channel_get(ccs811, SENSOR_CHAN_CO2, &co2);
    sensor_channel_get(ccs811, SENSOR_CHAN_VOC, &tvoc);
    sensor_channel_get(ccs811, SENSOR_CHAN_VOLTAGE, &voltage);
    sensor_channel_get(ccs811, SENSOR_CHAN_CURRENT, &current);
    float co2Value = (float) sensor_value_to_double(&co2);
    return co2Value;
}
```

## src/gasSensor.h
```c
#ifndef GASSENSOR_H_
#define GASSENSOR_H_

#include <stdint.h>

int initGasSensor();

float getGasValue();

#endif /* GASSENSOR_H_ */
```

## src/humidity.c
```c
#include "humidity.h"
#include <zephyr/drivers/sensor/ccs811.h>
#include <zephyr/drivers/sensor.h>
#include <zephyr/kernel.h>
#include <zephyr/device.h>
#include <stdint.h>
#include <sfloat.h>

const struct device *const hts221 = DEVICE_DT_GET_ONE(st_hts221);

int initHumiditySensor(){
    return !device_is_ready(hts221);
}

int readHumiditySensor(){
    int err = sensor_sample_fetch(hts221);
    if(err != 0){
        printk("Error on sample fetching data from hts221: %d\n", err);
        return -1;
    }
    return 0;
}

uint16_t getHumidityValue(){
    struct sensor_value hum;
    sensor_channel_get(hts221, SENSOR_CHAN_HUMIDITY, &hum);
    float humValue = (float) sensor_value_to_double(&hum);
    return sfloat_from_float(humValue).val;
}

uint16_t getTemperatureValue() {
    struct sensor_value temp;
    sensor_channel_get(hts221, SENSOR_CHAN_AMBIENT_TEMP, &temp);
    float tempValue = (float) sensor_value_to_double(&temp);
    return sfloat_from_float(tempValue).val;
}
```

## src/humidity.h
```c
#ifndef HUMIDITY_H_
#define HUMIDITY_H_

#include <stdint.h>

int initHumiditySensor();
int readHumiditySensor();

uint16_t getHumidityValue();
uint16_t getTemperatureValue();

#endif /* HUMIDITY_H_ */
```
